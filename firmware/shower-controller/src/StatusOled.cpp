#include "StatusOled.h"

#include <cstring>

namespace {
// Compact 5x7 uppercase font: ASCII 32 through 90.
const uint8_t FONT[][5] PROGMEM = {
  {0,0,0,0,0},{0,0,0x5F,0,0},{0,7,0,7,0},{0x14,0x7F,0x14,0x7F,0x14},
  {0x24,0x2A,0x7F,0x2A,0x12},{0x23,0x13,8,0x64,0x62},{0x36,0x49,0x55,0x22,0x50},
  {0,5,3,0,0},{0,0x1C,0x22,0x41,0},{0,0x41,0x22,0x1C,0},{0x14,8,0x3E,8,0x14},
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  {7,8,0x70,8,7},{0x61,0x51,0x49,0x45,0x43}
};
}

bool StatusOled::begin(TwoWire& wire, I2cHub& hub, int8_t channel, uint8_t address) {
  wire_ = &wire; hub_ = &hub; channel_ = channel; address_ = address;
  const uint8_t init[] = {0xAE,0xDC,0x00,0x81,0x80,0x20,0xA0,0xC0,0xA8,0x7F,
                          0xD3,0x60,0xD5,0x51,0xD9,0x22,0xDB,0x35,0xB0,0xDA,
                          0x12,0xA4,0xA6,0xAF};
  healthy_ = channel_ >= 0;
  for (uint8_t value : init) healthy_ = healthy_ && command(value);
  clear();
  return healthy_ && flush();
}

bool StatusOled::command(uint8_t value) {
  if (!healthy_ || !hub_->select(channel_)) return false;
  wire_->beginTransmission(address_); wire_->write(0x00); wire_->write(value);
  healthy_ = wire_->endTransmission() == 0;
  return healthy_;
}

void StatusOled::clear(bool on) { memset(buffer_, on ? 0xFF : 0x00, sizeof(buffer_)); }

void StatusOled::pixel(int x, int y, bool on) {
  // Logical landscape coordinates are 128 x 64; SH1107 memory is 64 x 128.
  if (x < 0 || x >= 128 || y < 0 || y >= 64) return;
  const int px = y;
  const int py = 127 - x;
  uint8_t& value = buffer_[(py >> 3) * 64 + px];
  const uint8_t mask = 1U << (py & 7);
  if (on) value |= mask; else value &= ~mask;
}

void StatusOled::text(const char* value, int x, int y, uint8_t scale, bool on) {
  while (*value) {
    char c = *value++;
    if (c >= 'a' && c <= 'z') c -= 32;
    if (c < 32 || c > 90) c = ' ';
    const uint8_t index = static_cast<uint8_t>(c - 32);
    for (int column = 0; column < 5; ++column) {
      const uint8_t bits = pgm_read_byte(&FONT[index][column]);
      for (int row = 0; row < 7; ++row) if (bits & (1U << row)) {
        for (int dx = 0; dx < scale; ++dx) for (int dy = 0; dy < scale; ++dy)
          pixel(x + column * scale + dx, y + row * scale + dy, on);
      }
    }
    x += 6 * scale;
  }
}

bool StatusOled::flush() {
  if (!healthy_) return false;
  for (uint8_t page = 0; page < 16; ++page) {
    if (!command(0xB0 | page) || !command(0x00) || !command(0x10)) return false;
    for (uint8_t offset = 0; offset < 64; offset += 16) {
      if (!hub_->select(channel_)) return false;
      wire_->beginTransmission(address_); wire_->write(0x40);
      wire_->write(buffer_ + page * 64 + offset, 16);
      if (wire_->endTransmission() != 0) { healthy_ = false; return false; }
    }
  }
  return true;
}

void StatusOled::showOpen(const char* message) {
  clear(true);
  text("OPEN", 40, 5, 2, false);
  const int width = strlen(message) * 6;
  text(message, max(0, (128 - width) / 2), 40, 1, false);
  flush();
}

void StatusOled::showInUse() {
  clear(false);
  text("IN USE", 10, 20, 3, true);
  flush();
}

void StatusOled::showUnavailable() {
  clear(false);
  text("OFFLINE", 22, 25, 2, true);
  flush();
}
